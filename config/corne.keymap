/* source key position labels */
#include "zmk-helpers/key-labels/36.h"

/* map Corne's extra keys */
#define X_LH  &kp LGUI      // thumb row, left
#define X_RH  &smart_mouse  // thumb row, right

/* activate bluetooth */
#define CONFIG_WIRELESS

/* source the main keymap */
#include "base.keymap"

/* use 5-column layout for Corne */
/{ chosen { zmk,physical-layout = &foostan_corne_5col_layout; }; };
